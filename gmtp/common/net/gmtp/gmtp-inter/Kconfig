## gmtp/common/net/gmtp/gmtp-inter/Kconfig
```kconfig
menu "GMTP-Inter Configuration"

config GMTP_INTER
	bool "Activate GMTP-Inter"
	depends on GMTP
	default y
	---help---
	  Enable GMTP-Inter.
endmenu
```
