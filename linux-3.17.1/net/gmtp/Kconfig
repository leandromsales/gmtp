## linux-3.17.1/net/gmtp/Kconfig
```kconfig
menuconfig GMTP
	tristate "The GMTP Protocol"
	depends on INET
	---help---
      Some text about it here ..
	  If in doubt, say N.
if GMTP

menu "GMTP Kernel Hacking"
config GMTP_PRI
	tristate "GMTP-Pri"
	default y
	---help---
      Some text about it here..
endmenu
endif # GMTP
```

## linux/host/old/linux-5.4.21/net/gmtp/gmtp-inter/Kconfig
```kconfig
menu "GMTP-Inter Configuration"

config GMTP_INTER
	bool "Activate GMTP-Inter"
    default y if (GMTP = y)
	---help---
	  Enable GMTP-Inter.
endmenu
```

## linux/ns3/old/linux-net-next-nuse-4.1.0-rc4/net/gmtp/Kconfig
```kconfig
menuconfig GMTP
	tristate "The GMTP Protocol"
	depends on INET
    default y

if GMTP

source "net/gmtp/gmtp-inter/Kconfig"

endif
```

## net-next-sim/net/gmtp/Kconfig
```kconfig
menuconfig GMTP
	tristate "The GMTP Protocol"
	depends on INET

if GMTP

source "net/gmtp/gmtp-inter/Kconfig"

endif
```

## net-next-sim/net/gmtp/gmtp-inter/Kconfig
```kconfig
menu "GMTP-Inter Configuration"

config GMTP_INTER
	bool "Activate GMTP-Inter"
	---help---
	  Enable GMTP-Inter.
	  If in doubt, say N.
endmenu
```

## src/main/kernel/linux/Kconfig
```kconfig
menuconfig IP_GMTP
	tristate "The GMTP Protocol (EXPERIMENTAL)"
	depends on INET && EXPERIMENTAL
	---help---
	  Global Media Transmission Protocol (draft-leandro-gmtp-00)

	  From http://www.ietf.org/id/draft-leandro-gmtp-00.txt:

	  The Global Media Transmission Protocol (GMTP) is a transport protocol
	  to be used in live streaming systems based on a hybrid P2P/CDN
	  architecture. The GMTP is divided into two parts named GMTP-inter
	  and GMTP-intra. The GMTP-intra is executed in the end-hosts that
	  receives multicast or unicast, congestion-controlled and unreliable
	  datagrams to playback the media. The GMTP-intra is responsible connect
	  to the remote server transmitting a specific content interested by the
	  end-user. On the other hand, GMTP-inter is executed in the network
	  routers to constitute a P2P overlay network by selecting peers also
	  interested in receiving the same media among interested peers. The
	  peers selected by the GMTP-inter, possibly other routers, can
	  contribute among them to improve the quality of experience of the
	  end-user. Also, GMTP-inter is responsible for authenticate in CDN
	  servers and receive a list of possible partner peers.

	  A GMTP application can initiate a socket which is allowed to accept
	  connections from different peers, although the destionation IP and
	  port is specified. The destionation IP and port specified is used to
	  match peers during the peer selection process and also to receive
	  datagrams from the server (probably servers that constitute a CDN) in
	  case no partner peer is available. It should be suitable for use by
	  applications such as large scale streaming media, Online TV,
	  videoconference and all similar application that transmit transient
	  and unreliable datagrams, namely, real-time straming applications.

	  To compile this protocol support as a module, choose M here: the
	  module will be called gmtp.

	  If in doubt, say N.
	def_tristate m


if IP_GMTP

config IP_GMTP_INTRA
	bool "GMTP Intra Network"
	---help---
	Implementation of the GMTP Intra Network, which allow applications to
	create P2P socket in the terms described in the GMTP Internet-Draft.

menuconfig IP_GMTP_INTER
	tristate "GMTP Inter Network"
	---help---
	Implementation of the GMTP Inter Network responsible for peer selection
	and authenticate in a GMTP overlay network.

if IP_GMTP_INTER

menu "GMTP Authentication Algorithms"

config IP_GMTP_AUTH_DEFAULT
	bool "GTMP Default Authentication Algorithm"
	default y

config IP_GMTP_AUTH_GOOGLE
	bool "GTMP Authentication for Google"
	default y

config IP_GMTP_AUTH_NETFLIX
	bool "GTMP Authentication for Netflix"
	default y

endmenu

menu "GMTP Peer Selection Algorithms"

config IP_GMTP_PEERSEL_DEFAULT
	bool "GTMP Default Peer Selection Algorithm"
	default y

endmenu

endif # IP_GMTP_INTER

config IP_GMTP_SECURITY
	bool "GMTP Security Layer"
	---help---
	The GMTP security layer provides a mechanism to authenticate and validate
	datagrams forwarded by partner peers. It it a recommended option since it
	avoids polution attack tentatives by malicious users. This features
	allow a GMTP box to check if the datagram was changed by a remote GMTP
	node compared to the original version of the datagram sent by a remote
	server.

	This module changes the GMTP connection process by adding an additional
	step: it firstly communicates with an original server and downloads the server
	certificate. The server certificate is then used to authtenticate each datagram
	not received from the original server, i.e, from partner peers.

menu "GMTP Congestion Control Algorithms"

config IP_GMTP_CUBIC
	bool "GTMP Default Congestion Control (based on TCP Cubic)"
	default y
	---help---
	This is the default congestion control algorithm implemented in GMTP, based on
	TCP Cubic congestion control algorithm.

config IP_GMTP_XCP
	bool "GTMP XCP (eXplicit Control Protocol) Congestion Control"
	---help---
	See http://www.isi.edu/isi-xcp

config IP_GMTP_RCP
	bool "GTMP RCP (Rate Control Protocol) Congestion Control"
	---help---
	See http://www.yuba.standford.edu/rcp

endmenu

menu "GMTP Kernel Hacking"
	depends on DEBUG_KERNEL=y

config IP_GMTP_DEBUG
	bool "GMTP debug messages"
	---help---
	Only use this if you're hacking GMTP.

	When compiling GMTP as a module, this debugging output can be toggled
	by setting the parameter gmtp_debug of the `gmtp' module to 0 or 1.

	Just say N.

config NET_GMTPPROBE
	tristate "GMTP connection probing"
	depends on PROC_FS && KPROBES
	---help---
	This module allows for capturing the changes to GMTP connection
	state in response to incoming packets. It is used for debugging
	GMTP congestion avoidance modules. If you don't understand
	what was just said, you don't need it: say N.

	Documentation on how to use GMTP connection probing can be found
	at:
	
	  http://www.linuxfoundation.org/collaborate/workgroups/networking/gmtpprobe

	To compile this code as a module, choose M here: the
	module will be called gmtp_probe.

endmenu

endif # IP_GMTP
```
